/*
 * tb_wake_fsm.v -- self-checking testbench for wake_fsm (DRH-1).
 *
 * tick_poll is generated by a TB-local divider (1-clk strobe every POLL_CLKS
 * clks) so poll-count checks are exact; vlow/vcrit/init_done are driven as
 * plain levels (sense_seq's latches, stubbed).
 *
 * Checks (all $fatal on failure -- real properties, not just activity):
 *   1. No tap response before init_done: a tap in WAIT_INIT produces no
 *      force_sense and no mode change -- and is NOT replayed after
 *      init_done rises (the edge must be consumed, not latched).
 *   2. Tap in IDLE -> exactly one 1-clk force_sense strobe and mode 01;
 *      the glow holds through GLOW_POLLS - 1 polls and ends exactly on the
 *      GLOW_POLLS-th tick_poll (off-by-one pinned, both directions).
 *      Plus the vlow gate: a tap with vlow high still strobes force_sense
 *      but must NOT glow (SPEC: "force_sense strobe, then if !vlow glow").
 *   3. Second tap during the glow -> mode 10 (sweep), no second
 *      force_sense strobe (design: strobe on IDLE taps only), sweep ends
 *      back at mode 00 after its GLOW_POLLS-poll window.
 *   4. vcrit mid-glow -> mode 00 + chg_dis high; taps ignored while
 *      dormant (no strobe, no mode change over 2 polls); recovery when
 *      vcrit drops: chg_dis released, no spontaneous glow, and the next
 *      tap glows normally.
 *   5. fd_n low -> nfc_en immediately; counter reloads while the field is
 *      held (still high across a poll with fd_n low); after release,
 *      nfc_en holds through NFC_HOLD_POLLS - 1 polls and drops exactly on
 *      the NFC_HOLD_POLLS-th tick_poll, then stays off.
 *   6. int2 is reserved: an int2 pulse changes nothing (mode, strobe count,
 *      nfc_en, chg_dis all unmoved).
 *   Invariant (every sampled cycle): chg_dis == 1 implies led_mode == 00,
 *   and no output is ever X after reset.
 *
 * All TB sampling is on negedge clk (NBA-updated DUT state stable), house
 * style per tb_gamma_pwm.v.
 */
`timescale 1ns/1ps

module tb_wake_fsm;

    localparam integer POLL_CLKS      = 64;   // clks per tick_poll (TB timebase)
    localparam integer GLOW_POLLS     = 4;    // mirror of the DUT parameters
    localparam integer NFC_HOLD_POLLS = 8;

    reg        clk = 1'b0;
    reg        rst_n = 1'b0;
    reg        int1 = 1'b0, int2 = 1'b0, fd_n = 1'b1;
    reg        vlow = 1'b0, vcrit = 1'b0, init_done = 1'b0;
    reg        tick_poll;
    reg [7:0]  pcnt;
    wire [1:0] led_mode;
    wire       force_sense, nfc_en, chg_dis;

    wake_fsm #(.GLOW_POLLS(GLOW_POLLS), .NFC_HOLD_POLLS(NFC_HOLD_POLLS)) dut (
        .clk(clk), .rst_n(rst_n),
        .tick_poll(tick_poll),
        .int1(int1), .int2(int2), .fd_n(fd_n),
        .vlow(vlow), .vcrit(vcrit), .init_done(init_done),
        .led_mode(led_mode), .force_sense(force_sense),
        .nfc_en(nfc_en), .chg_dis(chg_dis)
    );

    always #5 clk = ~clk;

    // watchdog (whole run is a few hundred polls of 64 clks)
    initial begin
        #10_000_000;
        $fatal(1, "TB TIMEOUT: did not reach TB PASS");
    end

    // tick_poll generator: 1-clk strobe every POLL_CLKS clks
    always @(posedge clk) begin
        if (!rst_n) begin
            pcnt      <= 8'd0;
            tick_poll <= 1'b0;
        end else begin
            tick_poll <= 1'b0;
            if (pcnt == POLL_CLKS - 1) begin
                pcnt      <= 8'd0;
                tick_poll <= 1'b1;
            end else begin
                pcnt <= pcnt + 8'd1;
            end
        end
    end

    /* ---- monitors: force_sense count/width, X screen, dormancy invariant ---- */
    integer fs_count;
    reg     fs_prev = 1'b0;
    reg     mon_on = 1'b0;

    always @(negedge clk) begin
        if (mon_on) begin
            if (force_sense === 1'bx || nfc_en === 1'bx || chg_dis === 1'bx ||
                ^led_mode === 1'bx)
                $fatal(1, "output X after reset: mode=%b fs=%b nfc=%b chg=%b",
                       led_mode, force_sense, nfc_en, chg_dis);
            if (force_sense === 1'b1) begin
                if (fs_prev)
                    $fatal(1, "force_sense high 2 consecutive cycles (not a 1-clk strobe)");
                fs_count = fs_count + 1;
            end
            fs_prev = (force_sense === 1'b1);
            if (chg_dis === 1'b1 && led_mode !== 2'b00)
                $fatal(1, "invariant broken: chg_dis high with led_mode %b", led_mode);
        end
    end

    /* ---- helpers ---- */
    task do_reset;
        begin
            mon_on = 1'b0;
            @(negedge clk);
            rst_n = 1'b0;
            int1 = 1'b0; int2 = 1'b0; fd_n = 1'b1;
            vlow = 1'b0; vcrit = 1'b0; init_done = 1'b0;
            repeat (4) @(negedge clk);
            fs_count = 0; fs_prev = 1'b0;
            mon_on = 1'b1;
            rst_n = 1'b1;
            @(negedge clk);
        end
    endtask

    task tap;                    // one rising int1 edge, held 3 clks
        begin
            @(negedge clk);
            int1 = 1'b1;
            repeat (3) @(negedge clk);
            int1 = 1'b0;
        end
    endtask

    task wait_poll;              // land on the negedge with tick_poll == 1
        begin
            @(negedge clk);
            while (tick_poll !== 1'b1) @(negedge clk);
        end
    endtask

    integer p;

    initial begin
        do_reset;

        /* ========== 1: dead before init_done ========== */
        tap;
        repeat (3 * POLL_CLKS) @(negedge clk);
        if (fs_count != 0)         $fatal(1, "1: force_sense fired before init_done");
        if (led_mode !== 2'b00)    $fatal(1, "1: led_mode %b before init_done", led_mode);
        if (nfc_en !== 1'b0)       $fatal(1, "1: nfc_en high with no field");
        init_done = 1'b1;
        repeat (3 * POLL_CLKS) @(negedge clk);
        if (fs_count != 0)         $fatal(1, "1: pre-init tap replayed after init_done");
        if (led_mode !== 2'b00)    $fatal(1, "1: spontaneous glow after init_done");
        $display("1 OK: tap before init_done ignored and not replayed after it");

        /* ========== 2: tap -> force_sense + glow for GLOW_POLLS polls ========== */
        wait_poll;                 // fixed phase: tap right after a poll tick
        tap;
        repeat (3) @(negedge clk);
        if (fs_count != 1)         $fatal(1, "2: %0d force_sense strobes after tap, expected 1", fs_count);
        if (led_mode !== 2'b01)    $fatal(1, "2: led_mode %b after tap, expected 01 (breathe)", led_mode);
        for (p = 1; p <= GLOW_POLLS; p = p + 1) begin
            wait_poll;
            repeat (2) @(negedge clk);          // let the poll's update land
            if (p < GLOW_POLLS) begin
                if (led_mode !== 2'b01)
                    $fatal(1, "2: glow ended early, poll %0d of %0d", p, GLOW_POLLS);
            end else begin
                if (led_mode !== 2'b00)
                    $fatal(1, "2: glow still on after GLOW_POLLS = %0d polls", GLOW_POLLS);
            end
        end
        $display("2 OK: tap -> one force_sense strobe, glow held %0d polls exactly", GLOW_POLLS);

        /* ---- 2b: vlow gates the glow but not the sense ---- */
        vlow = 1'b1;
        fs_count = 0;
        wait_poll;
        tap;
        repeat (3) @(negedge clk);
        if (fs_count != 1)         $fatal(1, "2b: vlow tap must still strobe force_sense");
        if (led_mode !== 2'b00)    $fatal(1, "2b: glow fired despite vlow");
        repeat (2 * POLL_CLKS) @(negedge clk);
        if (led_mode !== 2'b00)    $fatal(1, "2b: delayed glow despite vlow");
        vlow = 1'b0;
        $display("2b OK: tap with vlow -> force_sense strobed, no glow");

        /* ========== 3: second tap during glow -> sweep ========== */
        fs_count = 0;
        wait_poll;
        tap;                       // first tap: glow
        repeat (3) @(negedge clk);
        if (led_mode !== 2'b01)    $fatal(1, "3: first tap did not glow");
        wait_poll;                 // one poll into the glow
        tap;                       // second tap
        repeat (3) @(negedge clk);
        if (led_mode !== 2'b10)    $fatal(1, "3: second tap did not switch to sweep (mode %b)", led_mode);
        if (fs_count != 1)         $fatal(1, "3: sweep tap re-strobed force_sense (%0d strobes)", fs_count);
        for (p = 1; p <= GLOW_POLLS; p = p + 1) wait_poll;
        repeat (2) @(negedge clk);
        if (led_mode !== 2'b00)    $fatal(1, "3: sweep did not end after its %0d-poll window", GLOW_POLLS);
        $display("3 OK: second tap during glow -> sweep, no extra strobe, sweep ends");

        /* ========== 4: vcrit -> dormant, taps dead, recovery ========== */
        fs_count = 0;
        wait_poll;
        tap;                       // get a glow running so vcrit cuts an animation
        repeat (3) @(negedge clk);
        if (led_mode !== 2'b01)    $fatal(1, "4: setup glow did not start");
        @(negedge clk);
        vcrit = 1'b1;
        repeat (3) @(negedge clk);
        if (led_mode !== 2'b00)    $fatal(1, "4: vcrit did not force mode 00 (mode %b)", led_mode);
        if (chg_dis !== 1'b1)      $fatal(1, "4: vcrit did not assert chg_dis");
        fs_count = 0;
        tap;                       // taps must be ignored while dormant
        repeat (2 * POLL_CLKS) @(negedge clk);
        if (fs_count != 0)         $fatal(1, "4: force_sense fired on a dormant tap");
        if (led_mode !== 2'b00)    $fatal(1, "4: dormant tap changed led_mode");
        if (chg_dis !== 1'b1)      $fatal(1, "4: chg_dis dropped while vcrit held");
        vcrit = 1'b0;              // recovery
        repeat (3) @(negedge clk);
        if (chg_dis !== 1'b0)      $fatal(1, "4: chg_dis not released when vcrit dropped");
        if (led_mode !== 2'b00)    $fatal(1, "4: spontaneous glow on recovery");
        repeat (2 * POLL_CLKS) @(negedge clk);
        if (fs_count != 0)         $fatal(1, "4: dormant tap replayed after recovery");
        fs_count = 0;
        wait_poll;
        tap;                       // taps live again
        repeat (3) @(negedge clk);
        if (fs_count != 1)         $fatal(1, "4: tap dead after recovery (no strobe)");
        if (led_mode !== 2'b01)    $fatal(1, "4: tap after recovery did not glow");
        for (p = 1; p <= GLOW_POLLS; p = p + 1) wait_poll;   // let it run out
        repeat (2) @(negedge clk);
        if (led_mode !== 2'b00)    $fatal(1, "4: post-recovery glow did not end");
        $display("4 OK: vcrit cut the glow, chg_dis held, taps dead while dormant, clean recovery");

        /* ========== 5: fd_n low -> nfc_en for NFC_HOLD_POLLS polls ========== */
        if (nfc_en !== 1'b0)       $fatal(1, "5: nfc_en high before any field");
        wait_poll;
        @(negedge clk);
        fd_n = 1'b0;               // field arrives
        repeat (3) @(negedge clk);
        if (nfc_en !== 1'b1)       $fatal(1, "5: nfc_en not asserted on fd_n low");
        wait_poll;                 // field held across a poll: counter must reload
        repeat (2) @(negedge clk);
        if (nfc_en !== 1'b1)       $fatal(1, "5: nfc_en dropped while the field was still present");
        @(negedge clk);
        fd_n = 1'b1;               // field leaves; hold window starts here
        for (p = 1; p <= NFC_HOLD_POLLS; p = p + 1) begin
            wait_poll;
            repeat (2) @(negedge clk);
            if (p < NFC_HOLD_POLLS) begin
                if (nfc_en !== 1'b1)
                    $fatal(1, "5: nfc_en dropped early, poll %0d of %0d", p, NFC_HOLD_POLLS);
            end else begin
                if (nfc_en !== 1'b0)
                    $fatal(1, "5: nfc_en still high after NFC_HOLD_POLLS = %0d polls", NFC_HOLD_POLLS);
            end
        end
        repeat (2 * POLL_CLKS) @(negedge clk);
        if (nfc_en !== 1'b0)       $fatal(1, "5: nfc_en came back with no field");
        $display("5 OK: nfc_en on field, reloaded while held, off exactly %0d polls after release", NFC_HOLD_POLLS);

        /* ========== 6: int2 is reserved -- a pulse changes nothing ========== */
        fs_count = 0;
        @(negedge clk);
        int2 = 1'b1;
        repeat (3) @(negedge clk);
        int2 = 1'b0;
        repeat (2 * POLL_CLKS) @(negedge clk);
        if (fs_count != 0)         $fatal(1, "6: int2 pulse strobed force_sense");
        if (led_mode !== 2'b00)    $fatal(1, "6: int2 pulse changed led_mode");
        if (nfc_en !== 1'b0 || chg_dis !== 1'b0)
                                   $fatal(1, "6: int2 pulse moved nfc_en/chg_dis");
        $display("6 OK: int2 reserved -- pulse had no effect");

        $display("TB PASS: tb_wake_fsm");
        $finish;
    end

endmodule
